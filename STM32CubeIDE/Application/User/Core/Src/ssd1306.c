/*
 * ssd1306.c
 *
 *  Created on: 2026年5月29日
 *      Author:dd
 */
#include "ssd1306.h"
#include <string.h>
#include <string.h>
#include <stdlib.h>
#include <stdio.h>
#include "cmsis_os.h"
// 显存缓冲区（1KB）
static uint8_t buffer[SSD1306_WIDTH * SSD1306_HEIGHT / 8];
static uint16_t cursor_x = 0;
static uint16_t cursor_y = 0;

// 发送命令到 OLED
static void SSD1306_WriteCmd(uint8_t cmd) {
    uint8_t buf[2] = {0x00, cmd};   // 控制字节 0x00 表示命令
    HAL_I2C_Master_Transmit(&hi2c1, SSD1306_I2C_ADDR, buf, 2, 100);
}
#if 0
// 发送数据（一整块显存）
static void SSD1306_WriteData(uint8_t *data, uint16_t len) {
    uint8_t *buf = malloc(len + 1);
    if (buf == NULL) return;
    buf[0] = 0x40;   // 控制字节 0x40 表示数据
    memcpy(buf + 1, data, len);
    HAL_I2C_Master_Transmit(&hi2c1, SSD1306_I2C_ADDR, buf, len + 1, 100);
    free(buf);
}
#endif
static void SSD1306_WriteData(uint8_t *data, uint16_t len) {
    // 放弃使用 malloc，直接改为局部栈数组，防止标准堆内存枯竭
    uint8_t buf[SSD1306_WIDTH + 1];

    buf[0] = 0x40;   // 控制字节 0x40 表示数据
    if (len > SSD1306_WIDTH) len = SSD1306_WIDTH; // 增加防越界保护
    memcpy(buf + 1, data, len);

    HAL_I2C_Master_Transmit(&hi2c1, SSD1306_I2C_ADDR, buf, len + 1, 100);
}
// 初始化
void SSD1306_Init(void) {
    // 复位序列（根据数据手册）
 //   HAL_Delay(100);
	osDelay(100);
    SSD1306_WriteCmd(0xAE); // 关闭显示
    SSD1306_WriteCmd(0xD5); // 设置时钟分频
    SSD1306_WriteCmd(0x80);
    SSD1306_WriteCmd(0xA8); // 设置多路复用比
    SSD1306_WriteCmd(0x3F);
    SSD1306_WriteCmd(0xD3); // 显示偏移
    SSD1306_WriteCmd(0x00);
    SSD1306_WriteCmd(0x40); // 起始行
    SSD1306_WriteCmd(0x8D); // 电荷泵
    SSD1306_WriteCmd(0x14);
    SSD1306_WriteCmd(0x20); // 内存寻址模式
    SSD1306_WriteCmd(0x00);
    SSD1306_WriteCmd(0xA1); // 段重映射
    SSD1306_WriteCmd(0xC8); // COM 扫描方向
    SSD1306_WriteCmd(0xDA); // COM 引脚配置
    SSD1306_WriteCmd(0x12);
    SSD1306_WriteCmd(0x81); // 对比度
    SSD1306_WriteCmd(0xCF);
    SSD1306_WriteCmd(0xD9); // 预充电周期
    SSD1306_WriteCmd(0xF1);
    SSD1306_WriteCmd(0xDB); // VCOMH 取消选择电平
    SSD1306_WriteCmd(0x40);
    SSD1306_WriteCmd(0xA4); // 全局显示开启
    SSD1306_WriteCmd(0xA6); // 正常显示（非反色）
    SSD1306_WriteCmd(0xAF); // 开启显示

    SSD1306_Clear();
    SSD1306_Update();
}

// 清屏（所有像素清为 0）
void SSD1306_Clear(void) {
    memset(buffer, 0, sizeof(buffer));
}

// 将显存内容发送到屏幕
void SSD1306_Update(void) {
    // 设置页地址模式（每页8行）
    for (uint8_t page = 0; page < 8; page++) {
        SSD1306_WriteCmd(0xB0 + page);          // 设置页地址
        SSD1306_WriteCmd(0x00);                // 低列地址
        SSD1306_WriteCmd(0x10);                // 高列地址
        SSD1306_WriteData(&buffer[page * SSD1306_WIDTH], SSD1306_WIDTH);
    }
}

// 设置光标（像素坐标）
void SSD1306_GotoXY(uint16_t x, uint16_t y) {
    cursor_x = x;
    cursor_y = y;
}

// 显示字符（使用简单的5x7点阵）
static void SSD1306_DrawChar(char ch, uint16_t x, uint16_t y) {
    if (x > SSD1306_WIDTH - 6 || y > SSD1306_HEIGHT - 8) return;
    // 简易 ASCII 字模（5x7），只显示可打印字符 32-126
    static const uint8_t font5x7[][5] = {
        {0x00,0x00,0x00,0x00,0x00}, // 空格
        {0x00,0x00,0x5F,0x00,0x00}, // !
        // ... 此处略去大量字模，实际应包含完整 ASCII
        // 为简短，仅给出示例，运行时需完整字库
    };
    // 实际开发中建议使用现成的字库文件，或从网上复制完整 font5x7 数组
    // 此处仅示意，你需要补充完整字模（或使用现有库）
    // 为了不占篇幅，请从网络获取 5x7 点阵字库，或使用更简单的方法：显示数字/字符串用自己绘制
    // 由于时间关系，这里提供一种备用方式：使用 ssd1306 常用驱动库中的字体
}

// 🟢 绝对完整版：标准的 95 字符 5x7 ASCII 点阵字库（包含所有数字、大小写字母及常用标点）
static const uint8_t font5x7[95][5] = {
    {0x00, 0x00, 0x00, 0x00, 0x00}, // 32 空格
    {0x00, 0x00, 0x5F, 0x00, 0x00}, // 33 !
    {0x00, 0x07, 0x00, 0x07, 0x00}, // 34 "
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    {0x02, 0x01, 0x02, 0x01, 0x02}  // 126 ~
};
#if 0
void SSD1306_Puts(const char *str) {
    while (*str) {
        uint8_t ch = *str++;
        if (ch < 32 || ch > 126) ch = 32; // 不可打印字符替换为空格
        uint8_t idx = ch - 32;
        // 将字模绘制到 buffer 中（每个字符宽5像素，高7像素，留一列间隙）
        for (uint8_t col = 0; col < 5; col++) {
            uint8_t byte = font5x7[idx][col];
            for (uint8_t row = 0; row < 8; row++) {
                if (byte & (1 << row)) {
                    uint16_t x = cursor_x + col;
                    uint16_t y = cursor_y + row;
                    if (x < SSD1306_WIDTH && y < SSD1306_HEIGHT) {
                        buffer[x + (y / 8) * SSD1306_WIDTH] |= (1 << (y % 8));
                    }
                }
            }
        }
        cursor_x += 6; // 字符宽度+间隙
        if (cursor_x > SSD1306_WIDTH - 6) {
            cursor_x = 0;
            cursor_y += 8;
            if (cursor_y > SSD1306_HEIGHT - 8) {
                // 超出屏幕范围可滚动或清屏，这里简单处理：回到顶部并清屏
                cursor_y = 0;
                SSD1306_Clear();
            }
        }
    }
}
#endif
void SSD1306_Puts(const char *str) {
    while (*str) {
        uint8_t ch = *str++;

        // 遇到换行符，强制另起一行
        if (ch == '\n' || ch == '\r') {
            cursor_x = 0;
            cursor_y += 8;
            continue;
        }

        // 仅处理字库范围内的可见字符
        if (ch < 32 || ch > 126) ch = 32;
        uint8_t idx = ch - 32;

        for (uint8_t col = 0; col < 5; col++) {
            uint8_t byte = font5x7[idx][col];
            for (uint8_t row = 0; row < 8; row++) {
                if (byte & (1 << row)) {
                    uint16_t x = cursor_x + col;
                    uint16_t y = cursor_y + row;
                    if (x < SSD1306_WIDTH && y < SSD1306_HEIGHT) {
                        buffer[x + (y / 8) * SSD1306_WIDTH] |= (1 << (y % 8));
                    }
                }
            }
        }
        cursor_x += 6;

        // 自动换行保护
        if (cursor_x > SSD1306_WIDTH - 6) {
            cursor_x = 0;
            cursor_y += 8;
        }

        // 触底清屏保护
        if (cursor_y > SSD1306_HEIGHT - 8) {
            cursor_y = 0;
            SSD1306_Clear();
        }
    }
}
void SSD1306_PrintNumber(int32_t num) {
    char buf[16];
    sprintf(buf, "%ld", num);
    SSD1306_Puts(buf);
}

void SSD1306_PrintFloat(float num) {
    char buf[16];
    sprintf(buf, "%.1f", num);
    SSD1306_Puts(buf);
}

